## boards/tul/PynqZ2/board.yml
```yaml
board:
  name: pynqz2
  full_name: Pynqz2
  vendor: TuL
  socs:
  - name: xc7z020
```

## boards/tul/pynqz2/Kconfig.pynqz2
```kconfig
# TuL Pynqz2 board configuration

# Copyright (c) 2026 nalexopo
# SPDX-License-Identifier: Apache-2.0

config BOARD_PYNQZ2
	select SOC_XC7Z020
```
